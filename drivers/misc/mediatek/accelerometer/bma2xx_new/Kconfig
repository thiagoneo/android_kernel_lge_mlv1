## drivers/misc/mediatek/accelerometer/bma2xx_new/Kconfig
```kconfig
config MTK_BMA2XX_NEW
	bool "BMA253 for MediaTek package"
	default n
	help
	  It support different accelerometer sensor.
          If this option is set,
	  it will support
          KXTJ2_1009 Accelerometer.
```
